/*
 * Copyright 2021 Ettus Research, a National Instruments Brand
 *
 * SPDX-License-Identifier: LGPL-3.0-or-later
 */

/dts-v1/;
/plugin/;

#include "x410-version-info.dtsi"

#include "x410-fpga.dtsi"

#include "x4xx-common.dtsi"

#include "x410-rfdc.dtsi"

#include "x4xx-dma.dtsi"

#include "x4xx-100gbe-port0.dtsi"

#include "x4xx-100gbe-port1.dtsi"
