/*
 * Copyright 2026 Ettus Research, a National Instruments Brand
 *
 * SPDX-License-Identifier: LGPL-3.0-or-later
 */

/dts-v1/;
/plugin/;

#include "x420-version-info.dtsi"

#include "x420-fpga.dtsi"

#include "x4xx-common.dtsi"

#include "x420-rfdc.dtsi"

#include "x4xx-dma.dtsi"

#include "x4xx-10gbe-port0-x4.dtsi"
