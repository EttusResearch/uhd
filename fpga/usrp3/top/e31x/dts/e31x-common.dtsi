/*
 * Copyright (c) 2018 National Instruments Corp
 *
 * SPDX-License-Identifier: GPL-2.0 OR X11
 */

&fpga_full {
	uio@40010000 {
		compatible = "usrp-uio";
		reg = <0x40010000 0x2000>;
		reg-names = "mboard-regs";
		status = "okay";
	};
};

&spi0 {
	status = "okay";

	cs-gpios = <0>;

	spidev0: spidev@0 {
		compatible = "rohm,dh2228fv";
		reg = <0>;
		status = "okay";
		spi-max-frequency = <1000000>;
	};
};
